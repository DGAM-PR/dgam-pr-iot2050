## meta-dgam-pr/conf/layer.conf
```bitbake
# Layer configuration for meta-dgam-pr layer
BBPATH =. "${LAYERDIR}:"

BBFILES += "${LAYERDIR}/recipes-*/*/*.bb \
            ${LAYERDIR}/recipes-*/*/*.bbappend"

BBFILE_COLLECTIONS += "meta-dgam-pr"
BBFILE_PATTERN_meta-dgam-pr = "^${LAYERDIR}/"
BBFILE_PRIORITY_meta-dgam-pr = "10"

LAYERDEPENDS_meta-dgam-pr = "core iot2050"
LAYERSERIES_COMPAT_meta-dgam-pr = "scarthgap styhead"
```
